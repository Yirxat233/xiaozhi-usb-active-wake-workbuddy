## firmware/xiaozhi-esp32/sdkconfig.defaults.workbuddy
```kconfig
CONFIG_BOARD_TYPE_TAIJI_PI_S3=y
CONFIG_TAIJIPAI_I2S_TYPE_PDM=y
# CONFIG_TAIJIPAI_I2S_TYPE_STD is not set
CONFIG_SPIRAM_TRY_ALLOCATE_WIFI_LWIP=y
CONFIG_ESP_CONSOLE_USB_SERIAL_JTAG=y
# CONFIG_ESP_CONSOLE_UART_DEFAULT is not set
CONFIG_ESP_CONSOLE_SECONDARY_NONE=y
CONFIG_LANGUAGE_ZH_CN=y
```

## sdkconfig.defaults.workbuddy-viewe
```kconfig
CONFIG_BOARD_TYPE_VIEWE_SMARTRING_PLUS=y
CONFIG_USE_EMOTE_MESSAGE_STYLE=y
CONFIG_MMAP_FILE_NAME_LENGTH=32
CONFIG_FLASH_EXPRESSION_ASSETS=y
CONFIG_ESPTOOLPY_FLASHSIZE_16MB=y
CONFIG_PARTITION_TABLE_CUSTOM=y
CONFIG_PARTITION_TABLE_CUSTOM_FILENAME="partitions/v2/16m.csv"
CONFIG_ESP_CONSOLE_USB_SERIAL_JTAG=y
# CONFIG_ESP_CONSOLE_UART_DEFAULT is not set
CONFIG_ESP_CONSOLE_SECONDARY_NONE=y
CONFIG_COMPILER_OPTIMIZATION_ASSERTIONS_SILENT=y
CONFIG_LANGUAGE_ZH_CN=y
```
